## main/Kconfig.projbuild
```kconfig
menu "TG28-ESP PMIC"

    config TG28_I2C_PORT
        int "I2C port"
        range 0 1
        default 0

    config TG28_I2C_SDA
        int "I2C SDA GPIO"
        default 8 if IDF_TARGET_ESP32C3
        default 21

    config TG28_I2C_SCL
        int "I2C SCL GPIO"
        default 9 if IDF_TARGET_ESP32C3
        default 22

    config TG28_I2C_FREQUENCY
        int "I2C frequency (Hz)"
        range 10000 400000
        default 100000

    config TG28_CONFIRM_LOADS_DISCONNECTED
        bool "I have disconnected the battery and every downstream load"
        default n
        help
            This is a safety acknowledgement, not an operating mode. Keep it
            disabled during normal read-only inspection.

    config TG28_APPLY_ESP_CONFIGURATION
        bool "Write TG28-ESP rail and charger settings at startup"
        depends on TG28_CONFIRM_LOADS_DISCONNECTED
        default n
        help
            DANGER: changes live PMIC outputs. This option sets DCDC1 to 3.3 V,
            DCDC4 to 1.8 V, disables other configurable rails, and writes the
            selected charger current and voltage. Rebuild with this option off
            after the one-time configuration operation.

    config TG28_CHARGE_CURRENT_MA
        int "Constant-current charge setting (mA)"
        range 0 1500
        default 300
        depends on TG28_APPLY_ESP_CONFIGURATION
        help
            Valid values are 0 to 200 mA in 25 mA steps, then 300 to 1500 mA
            in 100 mA steps. Confirm the cell rating before changing this.

    choice TG28_CHARGE_VOLTAGE
        prompt "Charge target voltage"
        default TG28_CHARGE_VOLTAGE_4200
        depends on TG28_APPLY_ESP_CONFIGURATION

        config TG28_CHARGE_VOLTAGE_4000
            bool "4.00 V"
        config TG28_CHARGE_VOLTAGE_4100
            bool "4.10 V"
        config TG28_CHARGE_VOLTAGE_4200
            bool "4.20 V"
        config TG28_CHARGE_VOLTAGE_4350
            bool "4.35 V"
        config TG28_CHARGE_VOLTAGE_4400
            bool "4.40 V"
    endchoice

    config TG28_CHARGE_VOLTAGE_MV
        int
        default 4000 if TG28_CHARGE_VOLTAGE_4000
        default 4100 if TG28_CHARGE_VOLTAGE_4100
        default 4200 if TG28_CHARGE_VOLTAGE_4200
        default 4350 if TG28_CHARGE_VOLTAGE_4350
        default 4400 if TG28_CHARGE_VOLTAGE_4400

endmenu
```
